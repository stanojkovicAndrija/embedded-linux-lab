## linux-6.12.117/drivers/hello/Kconfig
```kconfig
config HELLO
	tristate "Hello World driver"
	help
	  A simple Hello World driver that prints messages
	  when initialized and removed.

	  Choose Y to build it into the kernel,
	  M to build it as a module, or N to disable it.
```

## linux-6.12.117/drivers/tmp105/Kconfig
```kconfig
config TMP105
	tristate "Temperature 105  driver"
	help
	  A simple Temperature driver that prints messages
	  when initialized and removed.

	  Choose Y to build it into the kernel,
	  M to build it as a module, or N to disable it.
```
